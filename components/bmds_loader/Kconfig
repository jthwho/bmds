## components/bmds_loader/Kconfig
```kconfig
menu "BMDS loader"

    config BMDS_IMAGE_CACHE_KB
        int "Program image cache (KB, PSRAM)"
        default 4096
        range 0 65536
        help
            Programs read from files are kept, checked and unrelocated, for
            the next exec of the same file, which then needs no card reads
            (devplan/programs.md section 14.1). Least recently used programs
            go first; all of them when memory runs short. 0 keeps none.

    config BMDS_IMAGE_WINDOW_MB
        int "Most of the PSRAM window programs' pages may hold at once (MB)"
        default 16
        range 0 32
        help
            Instances of a program share the 64 KB pages of its image that no
            relocation touches and nothing writes, mapped from its cache entry
            through the MMU into a range of the PSRAM window each; the rest of
            each instance is its own (devplan/programs.md section 14.2). The
            window is shared with large blocks (devplan/psramwindow.md); this
            caps programs' part of it. Costs addresses, not memory. 0 makes
            every program a plain copy.

    config BMDS_PROGRAM_RT_PRIORITY_LOW
        int "Lowest kernel priority of real-time program threads"
        default 7
        range 3 24
        help
            Program threads with SCHED_FIFO or SCHED_RR, 1-99, run at kernel
            priorities spread evenly from this one to
            BMDS_PROGRAM_RT_PRIORITY_HIGH (devplan/processes.md section 3.12):
            above the IP stack (BMDS_NET_STACK_PRIORITY) and the desktop,
            below the drivers.

    config BMDS_PROGRAM_RT_PRIORITY_HIGH
        int "Highest kernel priority of real-time program threads"
        default 18
        range BMDS_PROGRAM_RT_PRIORITY_LOW 24
        help
            Priority 99's. Keep it below the real-time audio clients
            (BMDS_AUDIO_CLIENT_PRIORITY) and the device tasks.

    config BMDS_STACK_PROBE
        bool "Measure the stack each system call uses (a measurement build)"
        default n
        help
            Every system call paints the program's stack below it on entry
            and finds how deep it went on return; `stackprobe` lists the
            deepest use of each slot, and of U-mode threads' kernel stacks
            by program (devplan/protection.md section 21). The floor under
            program stacks and the kernel stacks' size come from these
            figures (devplan/programs.md section 21): measure again when a
            slot that may go deep is added. Slows every call by up to
            a 16 KB fill and scan: never in a normal build.

    config BMDS_TRAP_ENTRY
        bool "BMDS's trap entry in front of ESP-IDF's"
        default y
        help
            mtvec and mtvt lead through BMDS's entry (trapentry.S) to
            ESP-IDF's handlers: the way into and out of U-mode for programs
            (devplan/protection.md section 4.2). Costs three instructions a
            trap from M-mode. Off only to measure that.

endmenu
```

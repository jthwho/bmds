/**
 * @file      log.cpp
 * @copyright Jason Howard. All rights reserved.
 *
 * SPDX-License-Identifier: MIT
 * See LICENSE file in the project root folder for license information.
 *
 * The history survives a reset, and a panic's report is written into it (devplan/logging.md §9).
 */

#include <cinttypes>
#include <cstddef>
#include <cstdio>
#include <cstring>
#include <esp_attr.h>
#include <esp_cache.h>
#include <esp_log_write.h>
#include <esp_private/panic_internal.h>
#include <rom/cache.h>
#include <sdkconfig.h>
#include <bmds/detail/platform.h>
#include <bmds/log.h>
#include <bmds/logtext.h>
#include <bmds/memory.h>
#include <bmds/mutex.h>
#include <bmds/staticobject.h>
#include <bmds/system.h>

#if CONFIG_BMDS_LOG_HISTORY_BYTES > 0 && !CONFIG_SPIRAM_ALLOW_NOINIT_SEG_EXTERNAL_MEMORY
#error "The log's history survives a reset in PSRAM's .noinit: CONFIG_SPIRAM_ALLOW_NOINIT_SEG_EXTERNAL_MEMORY"
#endif

// panic.c's: set while the panic is an abort, with its message.
extern "C" bool  g_panic_abort;
extern "C" char *g_panic_abort_details;

#if BMDS_ENABLE_DEBUG_LOG
// Bounds of the .bmds_debug section, generated by SURROUND(bmds_debug) in linker.lf.
extern "C" const bmds::DebugModule _bmds_debug_start[];
extern "C" const bmds::DebugModule _bmds_debug_end[];
#endif

BMDS_NAMESPACE_BEGIN

namespace {

        // A lock waiter gives up after this long and drops its line. The holder's
        // work is bounded (the serial sink drops output after its own short
        // timeout), so this only expires if something is badly wrong.
        constexpr unsigned int LockTimeoutMs = 100;

        constexpr size_t HistoryBytes = CONFIG_BMDS_LOG_HISTORY_BYTES;

        // The history, an overwrite-oldest text ring that survives a reset: `head` counts every
        // byte ever written, so `head - capacity` (when positive) is the oldest byte still held.
        struct Persistent {
                        // PSRAM's timing tuning writes a test pattern at physical 0x80..0xff at each
                        // boot, and the section may start at physical 0.
                        char     guard[256];
                        uint32_t magic;
                        uint32_t capacity;
                        uint64_t head;
                        uint64_t saved;             // in the files up to here (Log::setSaved()), or NoFiles
                        int64_t  wallMinusUptimeNs; // that boot's clock, 0 if unknown
                        char     history[HistoryBytes > 0 ? HistoryBytes : 1];
        };
        constexpr uint32_t PersistentMagic = 0x474f4c42; // "BLOG"

        EXT_RAM_NOINIT_ATTR Persistent persistent;

        // The header's counters again in the LP RAM, which a reset leaves alone and the caches don't
        // hold (devplan/keptstate.md §3): PSRAM's header can be lost dirty in a hardware reset.
        // `head` is stored after its bytes are written back, so it never runs ahead of them. Fields
        // stored one at a time (the LP RAM: about 500 ns a word).
        struct RtcCounters {
                        uint32_t magic;
                        uint32_t capacity;
                        uint64_t head;
                        uint64_t saved;
                        int64_t  wallMinusUptimeNs;
        };
        constexpr uint32_t RtcMagic = 0x43474f4c; // "LOGC"

        RTC_NOINIT_ATTR RtcCounters rtcCounters;

        // The header was written by a boot of this firmware (power-on contents pass with odds of
        // about 2^-64).
        bool isValid(const Persistent &p) {
                return p.magic == PersistentMagic && p.capacity == HistoryBytes &&
                       (p.saved <= p.head || p.saved == Log::NoFiles);
        }

        bool isValid(const RtcCounters &r) {
                return r.magic == RtcMagic && r.capacity == HistoryBytes &&
                       (r.saved <= r.head || r.saved == Log::NoFiles);
        }

        void resetPersistent(Persistent &p) {
                p.magic = PersistentMagic;
                p.capacity = HistoryBytes;
                p.head = 0;
                p.saved = 0;
                p.wallMinusUptimeNs = 0;
                RtcCounters &r = rtcCounters;
                r.magic = 0;
                r.capacity = HistoryBytes;
                r.head = 0;
                r.saved = 0;
                r.wallMinusUptimeNs = 0;
                r.magic = RtcMagic;
                return;
        }

        void writeBackBytes(const void *at, size_t len) {
                if (len > 0)
                        (void)esp_cache_msync(const_cast<void *>(at), len,
                                              ESP_CACHE_MSYNC_FLAG_DIR_C2M | ESP_CACHE_MSYNC_FLAG_UNALIGNED);
                return;
        }

        // Everything created by Log::init().
        struct LogState {
                        Mutex       mutex;
                        Persistent *history = nullptr; // null: no history
                        uint64_t    bootPosition = 0;
                        int64_t     recoveredWallMinusUptimeNs = 0;
        };

        constinit StaticObject<LogState> state;
        constinit Log::Sink              sink = nullptr;
        constinit WaitListOf<4>          readers; // released after each line (Log::waiters)

        constexpr char levelChar(LogLevel level) {
                switch (level) {
                        case LogLevel::Debug: return 'D';
                        case LogLevel::Info: return 'I';
                        case LogLevel::Warn: return 'W';
                        case LogLevel::Err: return 'E';
                }
                return '?';
        }

        // Clamps an snprintf() return value to the space actually written.
        size_t written(int ret, size_t avail) {
                if (ret < 0) return 0;
                return static_cast<size_t>(ret) < avail ? static_cast<size_t>(ret) : avail - 1;
        }

        // Into the ring only (the panic's path: it writes the caches back itself).
        void appendRing(Persistent &p, const char *text, size_t len) {
                if (len > HistoryBytes) {
                        text += len - HistoryBytes;
                        p.head += len - HistoryBytes;
                        len = HistoryBytes;
                }
                const size_t offset = static_cast<size_t>(p.head % HistoryBytes);
                const size_t first = len < HistoryBytes - offset ? len : HistoryBytes - offset;
                std::memcpy(p.history + offset, text, first);
                std::memcpy(p.history, text + first, len - first);
                p.head += len;
                return;
        }

        // Into the ring, its bytes written back from the caches (by address, under IDF's lock: safe
        // beside the other core's cache operations), then `head` stored in the LP RAM: what a hardware
        // reset leaves is up to date (about 5 µs a line, devplan/keptstate.md §3).
        void appendHistory(Persistent &p, const char *text, size_t len) {
                const uint64_t from = p.head + (len > HistoryBytes ? len - HistoryBytes : 0);
                appendRing(p, text, len);
                const size_t offset = static_cast<size_t>(from % HistoryBytes);
                const size_t n = static_cast<size_t>(p.head - from);
                const size_t first = n < HistoryBytes - offset ? n : HistoryBytes - offset;
                writeBackBytes(p.history + offset, first);
                writeBackBytes(p.history, n - first);
                if (isValid(rtcCounters)) rtcCounters.head = p.head;
                return;
        }

        void appendHistory(Persistent &p, const char *text) {
                appendHistory(p, text, std::strlen(text));
                return;
        }

        // Copies @p len bytes of the ring from @p from (still held) into @p dst.
        void copyOut(const Persistent &p, uint64_t from, char *dst, size_t len) {
                const size_t offset = static_cast<size_t>(from % HistoryBytes);
                const size_t first = len < HistoryBytes - offset ? len : HistoryBytes - offset;
                std::memcpy(dst, p.history + offset, first);
                std::memcpy(dst + first, p.history, len - first);
                return;
        }

        // The first position at or after @p from (older than the oldest byte held) where a whole
        // line starts.
        uint64_t firstWholeLine(const Persistent &p, uint64_t from) {
                const uint64_t oldest = p.head > HistoryBytes ? p.head - HistoryBytes : 0;
                if (from >= oldest) return from;
                from = oldest;
                if (oldest > 0) {
                        while (from < p.head && p.history[(from - 1) % HistoryBytes] != '\n') ++from;
                }
                return from;
        }

        // Writes the history back from the caches to PSRAM: a reset drops what they hold dirty, and
        // IDF's restart writes back only the L1 (devplan/logging.md §9).
        void writeBack() {
                const auto addr = static_cast<uint32_t>(reinterpret_cast<uintptr_t>(&persistent));
                (void)Cache_WriteBack_Addr(CACHE_MAP_L1_DCACHE, addr, sizeof(persistent));
                (void)Cache_WriteBack_Addr(CACHE_MAP_L2_CACHE, addr, sizeof(persistent));
                return;
        }

        void output(const char *text, size_t len) {
                if (!state.isCreated()) {
                        // Early boot: only the boot task runs, and stdout is IDF's polled console.
                        std::fwrite(text, 1, len, stdout);
                        return;
                }
                LogState     &s = *state;
                Mutex::Locker lock(s.mutex, LockTimeoutMs);
                if (!lock.isLocked()) return;
                if (s.history != nullptr) appendHistory(*s.history, text, len);
                readers.notify();
                if (sink != nullptr) {
                        sink(text, len);
                } else {
                        std::fwrite(text, 1, len, stdout);
                }
                return;
        }

        // `[  sec.mmm] L `, the uptime in milliseconds: the system timer, as Clock::monotonicNs() and
        // `uptime`, so the files' times are right. Not esp_log_timestamp(), which ran 0.58 s ahead
        // (its base is a cycle count taken across the boot's clock changes) and takes the kernel's
        // lock for the tick count.
        size_t stamp(char *buf, size_t cap, LogLevel level) {
                const auto ms = static_cast<uint32_t>(Detail::monotonicUs() / 1000);
                return written(std::snprintf(buf, cap, "[%5lu.%03u] %c ", static_cast<unsigned long>(ms / 1000),
                                             static_cast<unsigned>(ms % 1000), levelChar(level)),
                               cap);
        }

        // ESP-IDF log output (esp_log_set_vprintf). With CONFIG_LOG_VERSION_1 each
        // call is one complete line.
        int espLogVprintf(const char *fmt, va_list args) {
                char         buf[CONFIG_BMDS_LOG_LINE_MAX];
                const size_t len = written(std::vsnprintf(buf, sizeof(buf), fmt, args), sizeof(buf));
                output(buf, len);
                return static_cast<int>(len);
        }

} // namespace

Error Log::init() {
        LogState &s = state.create();
        if (HistoryBytes > 0) {
                Persistent &p = persistent;
                // The LP RAM's counters, when they pass, over PSRAM's header (which a hardware reset
                // may have dropped dirty): the bytes up to their `head` were written back.
                uint64_t           pastPsram = 0;
                const RtcCounters &r = rtcCounters;
                if (isValid(r)) {
                        if (isValid(p) && r.head > p.head) pastPsram = r.head - p.head;
                        p.magic = PersistentMagic;
                        p.capacity = HistoryBytes;
                        p.head = r.head;
                        p.saved = r.saved;
                        p.wallMinusUptimeNs = r.wallMinusUptimeNs;
                }
                // The previous boot's lines not yet in the files: put back in front of this boot's.
                char    *old = nullptr;
                size_t   oldLen = 0;
                uint64_t lost = 0;
                if (isValid(p) && p.saved != NoFiles && p.head > p.saved) {
                        const uint64_t from = firstWholeLine(p, p.saved);
                        lost = from - p.saved;
                        oldLen = static_cast<size_t>(p.head - from);
                        old = oldLen > 0 ? static_cast<char *>(Memory::alloc(MemSpace::Psram, oldLen)) : nullptr;
                        if (old != nullptr) copyOut(p, from, old, oldLen);
                        s.recoveredWallMinusUptimeNs = p.wallMinusUptimeNs;
                }
                resetPersistent(p);
                writeBackBytes(&p.magic, offsetof(Persistent, history) - offsetof(Persistent, magic));
                if (old != nullptr || lost > 0) {
                        char line[CONFIG_BMDS_LOG_LINE_MAX];
                        char past[64] = "";
                        if (pastPsram > 0)
                                std::snprintf(past, sizeof(past), "; %" PRIu64 " bytes past PSRAM's header", pastPsram);
                        std::snprintf(line, sizeof(line),
                                      "--- recovered: the previous boot's unsaved lines (reset: %s%s) ---\n",
                                      System::resetReason(), past);
                        appendHistory(p, line);
                        if (lost > 0) {
                                std::snprintf(line, sizeof(line), "--- %" PRIu64 " bytes of them lost ---\n", lost);
                                appendHistory(p, line);
                        }
                        if (old != nullptr) {
                                appendHistory(p, old, oldLen);
                                if (old[oldLen - 1] != '\n') appendHistory(p, "\n");
                                Memory::free(old);
                        }
                        appendHistory(p, "--- end of the recovered lines ---\n");
                }
                s.bootPosition = p.head;
                s.history = &p;
        }
        esp_log_set_vprintf(espLogVprintf);
        return Error::Ok;
}

void Log::setSink(Sink newSink) {
        if (!state.isCreated()) {
                sink = newSink;
                return;
        }
        Mutex::Locker lock(state->mutex, LockTimeoutMs);
        sink = newSink;
        return;
}

void Log::write(LogLevel level, const char *module, const char *file, int line, const char *fmt, ...) {
        va_list args;
        va_start(args, fmt);
        writeV(level, module, file, line, fmt, args);
        va_end(args);
        return;
}

void Log::writeV(LogLevel level, const char *module, const char *file, int line, const char *fmt, va_list args) {
        char   buf[CONFIG_BMDS_LOG_LINE_MAX];
        size_t len = 0;

        // Reserve one byte so the line can always be terminated with '\n'.
        constexpr size_t Cap = sizeof(buf) - 1;

        len += stamp(buf, Cap, level);
        if (module != nullptr) len += written(std::snprintf(buf + len, Cap - len, "%s: ", module), Cap - len);
        len += written(std::vsnprintf(buf + len, Cap - len, fmt, args), Cap - len);
        if (level >= LogLevel::Warn && file != nullptr) {
                len += written(std::snprintf(buf + len, Cap - len, " (%s:%d)", file, line), Cap - len);
        }
        buf[len++] = '\n';
        output(buf, len);
        return;
}

void Log::writeRaw(const char *text, size_t lengthBytes) {
        output(text, lengthBytes);
        return;
}

void Log::writeText(LogLevel level, StringView tag, StringView text) {
        if (level < _level) return;
        StringView rest = text;
        do {
                const StringView line = LogText::nextLine(rest);
                char             buf[CONFIG_BMDS_LOG_LINE_MAX];
                constexpr size_t Cap = sizeof(buf) - 1; // room for the '\n'
                size_t           len = stamp(buf, Cap, level);
                if (!tag.isEmpty() && len + 2 < Cap) {
                        len += LogText::cleanLine(tag, buf + len, Cap - len - 2);
                        buf[len++] = ':';
                        buf[len++] = ' ';
                }
                len += LogText::cleanLine(line, buf + len, Cap - len);
                buf[len++] = '\n';
                output(buf, len);
        } while (!rest.isEmpty());
        return;
}

uint64_t Log::position() {
        if (!state.isCreated() || state->history == nullptr) return 0;
        Mutex::Locker lock(state->mutex, LockTimeoutMs);
        return state->history->head;
}

uint64_t Log::bootPosition() {
        return state.isCreated() ? state->bootPosition : 0;
}

int64_t Log::recoveredWallMinusUptimeNs() {
        return state.isCreated() ? state->recoveredWallMinusUptimeNs : 0;
}

void Log::setSaved(uint64_t position, int64_t wallMinusUptimeNs) {
        if (!state.isCreated() || state->history == nullptr) return;
        Mutex::Locker lock(state->mutex, LockTimeoutMs);
        if (!lock.isLocked()) return;
        Persistent &p = *state->history;
        if (position != NoFiles && position > p.head) position = p.head;
        p.saved = position;
        p.wallMinusUptimeNs = wallMinusUptimeNs;
        RtcCounters &r = rtcCounters;
        if (isValid(r)) {
                r.wallMinusUptimeNs = wallMinusUptimeNs;
                r.saved = position;
        }
        return;
}

size_t Log::read(uint64_t &position, Span<char> dst, uint64_t &lostBytes) {
        lostBytes = 0;
        if (!state.isCreated() || state->history == nullptr || dst.isEmpty()) return 0;
        LogState     &s = *state;
        Mutex::Locker lock(s.mutex, LockTimeoutMs);
        const Persistent &p = *s.history;
        if (!lock.isLocked() || position >= p.head) return 0;

        // When the oldest byte held is past @p position, the copy starts at the first line that
        // begins after it (the one it is in may have lost its start).
        const uint64_t from = firstWholeLine(p, position);
        lostBytes = from - position;
        if (from >= p.head) {
                position = from;
                return 0;
        }
        const uint64_t avail = p.head - from;
        size_t         len = static_cast<size_t>(avail < dst.size() ? avail : dst.size());
        copyOut(p, from, dst.data(), len);
        // Complete lines only, unless one line is longer than @p dst.
        if (dst[len - 1] != '\n') {
                size_t end = len;
                while (end > 0 && dst[end - 1] != '\n') --end;
                if (end > 0) len = end;
        }
        position = from + len;
        return len;
}

WaitList &Log::waiters() {
        return readers;
}

size_t Log::copyHistory(Span<char> dst) {
        if (!state.isCreated() || state->history == nullptr || dst.isEmpty()) return 0;
        LogState     &s = *state;
        Mutex::Locker lock(s.mutex, LockTimeoutMs);
        const Persistent &p = *s.history;
        if (!lock.isLocked()) return 0;

        const uint64_t held = p.head < HistoryBytes ? p.head : HistoryBytes;
        const size_t   len = static_cast<size_t>(held < dst.size() ? held : dst.size());
        copyOut(p, p.head - len, dst.data(), len);

        // If older text was cut off, drop the partial first line.
        if (p.head > len) {
                size_t skip = 0;
                while (skip < len && dst[skip] != '\n') ++skip;
                if (skip < len) ++skip;
                std::memmove(dst.data(), dst.data() + skip, len - skip);
                return len - skip;
        }
        return len;
}

size_t Log::historyCapacity() {
        return state.isCreated() && state->history != nullptr ? HistoryBytes : 0;
}

Span<const DebugModule> Log::debugModules() {
#if BMDS_ENABLE_DEBUG_LOG
        return Span<const DebugModule>(_bmds_debug_start, static_cast<size_t>(_bmds_debug_end - _bmds_debug_start));
#else
        return Span<const DebugModule>();
#endif
}

const DebugModule *Log::findDebugModule(StringView name) {
        for (const DebugModule &m : debugModules()) {
                if (name == m.name) return &m;
        }
        return nullptr;
}

namespace {

        // A panic's report, written into the history as log lines `[  sec.mmm] E panic: text`
        // (devplan/logging.md §9). Without the log's lock: the other core is stalled, and the
        // holder may be the task that panicked.
        constinit bool panicLineOpen = false;

        void panicPut(char c) {
                if (HistoryBytes == 0) return;
                Persistent &p = persistent;
                if (!isValid(p)) resetPersistent(p); // a panic before Log::init() on a cold boot
                if (c == '\r') return;
                if (c == '\n') {
                        if (!panicLineOpen) return; // blank lines left out
                        appendRing(p, "\n", 1);
                        panicLineOpen = false;
                        writeBack(); // in case the handler hangs until the hardware watchdog
                        if (isValid(rtcCounters)) rtcCounters.head = p.head;
                        return;
                }
                if (!panicLineOpen) {
                        // The stamp by hand: no snprintf() here. The timer's register, no lock.
                        const uint64_t ms = static_cast<uint64_t>(Detail::monotonicUs()) / 1000;
                        char           buf[40];
                        char          *end = buf + sizeof(buf);
                        char          *at = end;
                        constexpr char Tail[] = "] E panic: ";
                        at -= sizeof(Tail) - 1;
                        std::memcpy(at, Tail, sizeof(Tail) - 1);
                        uint64_t v = ms;
                        for (int i = 0; i < 3; ++i, v /= 10) *--at = char('0' + v % 10);
                        *--at = '.';
                        int digits = 0;
                        do {
                                *--at = char('0' + v % 10);
                                v /= 10;
                                ++digits;
                        } while (v != 0);
                        while (digits++ < 5) *--at = ' ';
                        *--at = '[';
                        appendRing(p, at, static_cast<size_t>(end - at));
                        panicLineOpen = true;
                }
                appendRing(p, &c, 1);
                return;
        }

        void panicPutStr(const char *str) {
                while (str != nullptr && *str != '\0') panicPut(*str++);
                return;
        }

} // namespace

BMDS_NAMESPACE_END

// IDF's panic output, copied into the history as it goes to the console. --wrap reaches only
// the calls from other files: the register dump and the backtrace come through these, but
// panic.c's own lines (the headline, an abort's message) don't, so esp_panic_handler's wrap
// writes those.
extern "C" {

void              __real_panic_print_char(char c);
void              __real_panic_print_str(const char *str);
void              __real_panic_print_dec(int d);
void              __real_panic_print_hex(int h);
void              __real_esp_panic_handler(panic_info_t *info);
[[noreturn]] void __real_esp_restart_noos(void);

void __wrap_panic_print_char(char c) {
        __real_panic_print_char(c);
        bmds::panicPut(c);
        return;
}

void __wrap_panic_print_str(const char *str) {
        __real_panic_print_str(str);
        bmds::panicPutStr(str);
        return;
}

// As panic.c prints it: two digits, a space for the tens of one below 10.
void __wrap_panic_print_dec(int d) {
        __real_panic_print_dec(d);
        const int n1 = d % 10, n2 = d / 10;
        bmds::panicPut(n2 == 0 ? ' ' : char('0' + n2));
        bmds::panicPut(char('0' + n1));
        return;
}

// As panic.c prints it: eight hex digits.
void __wrap_panic_print_hex(int h) {
        __real_panic_print_hex(h);
        uint32_t v = static_cast<uint32_t>(h);
        for (int x = 0; x < 8; ++x, v <<= 4) bmds::panicPut("0123456789abcdef"[v >> 28]);
        return;
}

void __wrap_esp_panic_handler(panic_info_t *info) {
        if (g_panic_abort) {
                bmds::panicPutStr("abort: ");
                bmds::panicPutStr(g_panic_abort_details != nullptr ? g_panic_abort_details : "(no message)");
                bmds::panicPut('\n');
        } else if (info->reason != nullptr) {
                bmds::panicPutStr("Guru Meditation Error: Core ");
                bmds::panicPut(char('0' + info->core));
                bmds::panicPutStr(" panic'ed (");
                bmds::panicPutStr(info->reason);
                bmds::panicPutStr("). ");
                bmds::panicPutStr(info->description);
                bmds::panicPut('\n');
        }
        __real_esp_panic_handler(info);
        return;
}

// Every reset by software comes here: a panic's, a watchdog's abort, a reboot.
void __wrap_esp_restart_noos(void) {
        if (bmds::HistoryBytes > 0) bmds::writeBack();
        __real_esp_restart_noos();
}

} // extern "C"

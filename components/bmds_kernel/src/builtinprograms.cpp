/**
 * @file      builtinprograms.cpp
 * @copyright Jason Howard. All rights reserved.
 *
 * SPDX-License-Identifier: MIT
 * See LICENSE file in the project root folder for license information.
 *
 * The programs built into the firmware (devplan/programs.md §17).
 */

#include <bmds/builtinprograms.h>

#if defined(ESP_PLATFORM)
// Bounds of the sorted program table, generated by SURROUND(bmds_prog) in linker.lf.
extern "C" const bmds::ProgramEntry _bmds_prog_start[];
extern "C" const bmds::ProgramEntry _bmds_prog_end[];
#endif

BMDS_NAMESPACE_BEGIN

namespace {

#if !defined(ESP_PLATFORM)
        constinit Span<const ProgramEntry> hostEntries;
#endif

} // namespace

Span<const ProgramEntry> BuiltinPrograms::all() {
#if defined(ESP_PLATFORM)
        return Span<const ProgramEntry>(_bmds_prog_start, static_cast<size_t>(_bmds_prog_end - _bmds_prog_start));
#else
        return hostEntries;
#endif
}

void BuiltinPrograms::detail::setForHost(Span<const ProgramEntry> entries) {
#if !defined(ESP_PLATFORM)
        hostEntries = entries;
#else
        (void)entries;
#endif
        return;
}

const ProgramEntry *BuiltinPrograms::find(StringView name) {
        const Span<const ProgramEntry> entries = all();
        size_t                         lo = 0, hi = entries.size();
        while (lo < hi) {
                const size_t     mid = (lo + hi) / 2;
                const StringView here(entries[mid].name);
                if (here == name) return &entries[mid];
                if (here < name) {
                        lo = mid + 1;
                } else {
                        hi = mid;
                }
        }
        return nullptr;
}

BMDS_NAMESPACE_END

## components/bmds_board/Kconfig
```kconfig
menu "BMDS board"

    choice BMDS_BOARD
        prompt "Target board"
        default BMDS_BOARD_OLIMEX_ESP32P4_PC
        help
            The board BMDS is built for. Selects the board definition
            (components/bmds_board/boards/<board>/) that holds all pin
            assignments and hardware facts.

        config BMDS_BOARD_OLIMEX_ESP32P4_PC
            bool "Olimex ESP32-P4-PC"
            depends on IDF_TARGET_ESP32P4
    endchoice

    config BMDS_BOARD_DIR
        string
        default "olimex_esp32p4_pc" if BMDS_BOARD_OLIMEX_ESP32P4_PC

endmenu
```

## components/bmds_console/Kconfig
```kconfig
menu "BMDS console"

    config BMDS_USJ_TX_BYTES
        int "USB-Serial/JTAG console output buffer (bytes, power of two)"
        default 1024
        range 128 65536
        help
            Output ring buffer of the USB-Serial/JTAG console, in PSRAM.
            The host drains about 64 bytes per millisecond while the serial
            port is open. Must be a power of two.

    config BMDS_USJ_RX_BYTES
        int "USB-Serial/JTAG console input buffer (bytes, power of two)"
        default 4096
        range 64 65536
        help
            Input ring buffer of the USB-Serial/JTAG console, in PSRAM. It
            holds input that arrives while a command runs (e.g. a paste, or
            a YMODEM block while rz writes to the card); there is no flow
            control, so input beyond it is dropped. Must be a power of two.

    choice BMDS_USJ_COLOR_DEPTH
        prompt "USB-Serial/JTAG console color depth"
        default BMDS_USJ_COLOR_TRUECOLOR
        help
            Colors the terminal on the other end of the serial port shows.
            The console can't detect it; output with more colors is
            rewritten to fit. Change it at run time with `term color`.

        config BMDS_USJ_COLOR_TRUECOLOR
            bool "24-bit (truecolor)"
        config BMDS_USJ_COLOR_256
            bool "256 colors"
        config BMDS_USJ_COLOR_16
            bool "16 colors"
        config BMDS_USJ_COLOR_NONE
            bool "No color"
    endchoice

endmenu
```

## components/bmds_kernel/Kconfig
```kconfig
menu "BMDS kernel"

    config BMDS_ASSERT
        bool "Enable BMDS_ASSERT checks"
        default y
        help
            Compile in BMDS_ASSERT invariant checks. A failed assert panics
            with a backtrace. Disabling saves a little flash and CPU.

    config BMDS_DEBUG_LOG
        bool "Compile in bmdsDebug() logging"
        default y
        help
            Compile in per-module debug logging. Modules are still off at
            runtime until enabled. Disabling removes all debug log strings
            and the module registry.

    config BMDS_LOG_LINE_MAX
        int "Maximum log line length"
        default 160
        range 64 1024
        help
            Size of the on-stack buffer a log line is formatted into.
            Longer lines are truncated.

    config BMDS_LOG_HISTORY_BYTES
        int "Log history size (bytes, PSRAM)"
        default 65536
        range 0 1048576
        help
            Size of the ring that keeps recent log text for 'log show' and for the log files
            (devplan/logging.md: the lines from before the card mounts).
            Allocated from PSRAM at boot. 0 disables the history.

    config BMDS_PIPE_BYTES
        int "Pipe buffer size (bytes, PSRAM)"
        default 4096
        range 256 65536
        help
            Ring size of each pipe between pipeline stages. Must be a power
            of two. Allocated from PSRAM when the pipeline starts and freed
            when it ends.

    config BMDS_TIMEZONE
        string "Kernel time zone (POSIX TZ string or zone name)"
        default "UTC0"
        help
            The time zone the kernel shows time in and stamps FAT files
            with (FAT stores local time). A POSIX TZ string, e.g.
            "CET-1CEST,M3.5.0,M10.5.0/3" or "EST5EDT,M3.2.0,M11.1.0", or
            a name in the time zone database on the card, e.g.
            "Europe/Berlin" (UTC until the card's database is found).
            The default of the system configuration's clock/zone, which
            'sysconf' changes at run time.
            The clock itself keeps UTC; the shell's TZ variable overrides
            the zone for display.

endmenu
```

## components/bmds_loader/Kconfig
```kconfig
menu "BMDS loader"

    config BMDS_IMAGE_CACHE_KB
        int "Program image cache (KB, PSRAM)"
        default 4096
        range 0 65536
        help
            Programs read from files are kept, checked and unrelocated, for
            the next exec of the same file, which then needs no card reads
            (devplan/programs.md section 14.1). Least recently used programs
            go first; all of them when memory runs short. 0 keeps none.

    config BMDS_IMAGE_WINDOW_MB
        int "Most of the PSRAM window programs' pages may hold at once (MB)"
        default 16
        range 0 32
        help
            Instances of a program share the 64 KB pages of its image that no
            relocation touches and nothing writes, mapped from its cache entry
            through the MMU into a range of the PSRAM window each; the rest of
            each instance is its own (devplan/programs.md section 14.2). The
            window is shared with large blocks (devplan/psramwindow.md); this
            caps programs' part of it. Costs addresses, not memory. 0 makes
            every program a plain copy.

    config BMDS_PROGRAM_RT_PRIORITY_LOW
        int "Lowest kernel priority of real-time program threads"
        default 7
        range 3 24
        help
            Program threads with SCHED_FIFO or SCHED_RR, 1-99, run at kernel
            priorities spread evenly from this one to
            BMDS_PROGRAM_RT_PRIORITY_HIGH (devplan/processes.md section 3.12):
            above the IP stack (BMDS_NET_STACK_PRIORITY) and the desktop,
            below the drivers.

    config BMDS_PROGRAM_RT_PRIORITY_HIGH
        int "Highest kernel priority of real-time program threads"
        default 18
        range BMDS_PROGRAM_RT_PRIORITY_LOW 24
        help
            Priority 99's. Keep it below the real-time audio clients
            (BMDS_AUDIO_CLIENT_PRIORITY) and the device tasks.

endmenu
```

## components/bmds_net/Kconfig
```kconfig
menu "BMDS network"

    config BMDS_NET_PRIORITY
        int "Ethernet device task priority"
        default 21
        range 1 24
        help
            The task of each Ethernet device (devplan/network.md §4): it takes the frames the
            DMA has received, reclaims sent ones and checks the link. Above the audio engine,
            so real-time frames (PTP, AES67) reach their consumers without waiting for it.

    config BMDS_NET_STACK_PRIORITY
        int "IP stack task priority"
        default 6
        range 1 24
        help
            The network task (devplan/network.md §15): it gives received frames to lwIP and
            runs lwIP's timers. Above the window manager, so the network keeps up while the
            screen is busy; below audio, which bulk traffic must never hold up.

    config BMDS_NET_HEAP_KB
        int "IP stack heap (KB of internal RAM)"
        default 64
        range 32 256
        help
            lwIP's heap, one block of internal DMA memory from boot (devplan/network.md §29):
            its pbufs, segments and control blocks. The Ethernet DMA sends frames from it in
            place (it can't send from PSRAM). A connection moving data at full speed both ways
            holds up to about 50 KB (a bulk transfer one way measured 28 KB); with less room
            senders wait and received frames are dropped and retransmitted.

endmenu
```

## components/bmds_shell/Kconfig
```kconfig
menu "BMDS shell"

    config BMDS_SHELL_STACK_BYTES
        int "Shell task stack size (bytes, PSRAM)"
        default 65536
        range 16384 262144
        help
            Stack of each shell task, in PSRAM. The interpreter and the
            commands run on it; deep recursion is stopped with an error
            before it runs out. Each level of a function that recurses
            through $(...) takes about 2.5 KB, a plain recursive call about
            1 KB. Check the 'tasks' command's stack_free
            column before shrinking.

    config BMDS_SHELL_WORKER_STACK_BYTES
        int "Pipeline worker stack size (bytes, PSRAM)"
        default 32768
        range 8192 131072
        help
            Stack of each worker thread that runs an earlier stage of a
            pipeline. In PSRAM, so a pipeline costs internal RAM only for
            the workers' control blocks.

    config BMDS_SHELL_PRIORITY
        int "Shell task priority"
        default 2
        range 1 24
        help
            FreeRTOS priority of shell tasks. Commands run at this priority.

endmenu
```

## components/bmds_storage/Kconfig
```kconfig
menu "BMDS storage"

    config BMDS_STORAGE_STACK_BYTES
        int "Storage task stack size (bytes, PSRAM)"
        default 6144
        range 3072 65536
        help
            Stack of the storage service task, which handles card insertion
            and removal (card initialization, and later mounting). In PSRAM.
            Check the 'tasks' command's stack_free column before shrinking.

    config BMDS_STORAGE_PRIORITY
        int "Storage task priority"
        default 3
        range 1 24
        help
            FreeRTOS priority of the storage task. Above the shell, so a
            removed card is noticed while a command is busy.

    config BMDS_SD_MAX_KHZ
        int "SD card bus clock limit (kHz)"
        default 40000
        range 400 40000
        help
            Highest SD bus clock. 40000 is high speed (about 20 MB/s on a
            4-bit bus) for cards that support it; others stay at the default
            speed, 20000. Lower it to rule out signal problems.

    config BMDS_SD_BOUNCE_BYTES
        int "SD bounce buffer size (bytes, PSRAM)"
        default 65536
        range 512 65536
        help
            DMA-capable buffer that requests in buffers the SD host can't
            reach by DMA (unaligned, or not DMA-capable) are copied through,
            so the driver never allocates per request. A multiple of 512.
            Larger is faster for such requests (one card command a buffer):
            reading a file through the VFS 4.9 MB/s at 4 KB, 9.4 at 32 KB,
            10.1 at 64 KB (devplan/bench.md §19). Aligned PSRAM buffers
            don't use it.

    config BMDS_ZONEINFO_PATH
        string "Time zone database"
        default "/sd0/p0/share/zoneinfo.bin"
        help
            The time zone database (one file, built by tools/bmds-dist as
            the tzdata package), shown to programs as /share/zoneinfo and
            used for zone names in clock/zone, CONFIG_BMDS_TIMEZONE and
            TZ. The default of the system configuration's clock/tzdata,
            which 'sysconf' changes at run time.

    config BMDS_LEAPSECONDS_PATH
        string "Leap-second list"
        default "/sd0/p0/share/leap-seconds.list"
        help
            IANA's leap-seconds.list (the tzdata package's), for CLOCK_TAI and PTP's UTC
            offset (devplan/network.md §31e). The ROM's /rom/share/leap-seconds.list is used
            while none is there, or when it expires later. The default of the system
            configuration's clock/leapseconds.

endmenu
```

## components/bmds_ui/Kconfig
```kconfig
menu "BMDS desktop"

    config BMDS_DESKTOP_COLOR
        hex "Desktop color (0xRRGGBB)"
        default 0x404040
        help
            The flat color of the desktop under the windows
            (devplan/windows.md W6). The default is a dark grey.

endmenu
```
